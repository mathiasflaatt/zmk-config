/* source keypos definitions */
#include "../zmk-nodefree-config/keypos_def/keypos_adv360.h"

/* map 360's extra keys */
#define X_LT    &kp ESCAPE &mt EXCL N1  &mt AT N2  &mt HASH N3 &mt DLLR N4 &mt PRCNT N5 &tog MOUSE     &mo SYS &mt CARET N6 &mt AMPS N7  &mt RS(STAR) N8 &mt LPAR N9  &mt RPAR N0 &kp MINUS \
                &kp TAB
#define X_MT    &kp SLASH  &kp LS(LA(MINUS))
#define X_RT    &kp BSLH

#define X_LM    &kp DEL 
#define X_MM    &kp MINUS &copy_cut   &kp LG(V)             &kp LG(LS(R))  &kp LS(LC(LALT)) &kp EQUAL 
#define X_RM    &kp SQT

#define X_LB    &kp LSHFT
#define X_RB    &kp RSHFT
#define X_MB    &kp C_PREV &kp C_NEXT  

#define X_LH    &mo 2 &kp GRAVE &kp CAPS &kp LEFT &kp RIGHT  
#define X_MH    &kp SINGLE_QUOTE     &kp DOUBLE_QUOTES
#define X_RH    &kp UP &kp DOWN &kp LBKT &kp RBKT &mo 3

/* activate bluetooth */
#define CONFIG_WIRELESS 1

/* leds and backlights */
#include <dt-bindings/zmk/rgb.h>
#include <dt-bindings/zmk/backlight.h>

/* source the main keymap */
#include "base.keymap"